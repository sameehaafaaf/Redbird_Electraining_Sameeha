VERSION ""

NS_ :

BS_:
BU_:
BO_ 1680 Sent__message: 0 Vector__XXX
   SG_ analog_reading : 7|16@0+ (1,0) [0|1] "" Vector__XXX

BO_ 1056 Request__message: 0 Vector__XXX
   SG_ request__byte : 7|8@0+ (1,0) [0|1] "" Vector__XXX

BA_DEF_ BO_ "GenMsgBackgroundColor" STRING ;
BA_DEF_ BO_ "GenMsgForegroundColor" STRING ;
BA_DEF_ BO_ "filterlabeling" INT 0 0;
BA_DEF_ BO_ "filterlabeling" INT 0 0;
BA_ "GenMsgForegroundColor" BO_ 1680 "#0000ff";
BA_ "GenMsgBackgroundColor" BO_ 1680 "#aaffff";
BA_ "GenMsgForegroundColor" BO_ 1056 "#aa0000";
BA_ "GenMsgBackgroundColor" BO_ 1056 "#ffaaff";
BA_DEF_DEF_ "GenMsgBackgroundColor" "#ffffff";
BA_DEF_DEF_ "GenMsgForegroundColor" "#000000";
BA_DEF_DEF_ "filterlabeling" 1;
BA_DEF_DEF_ "filterlabeling" true;
VAL_ 1680 analog_reading 0 "0";
VAL_ 1056 request__byte 105 "Request_Sent";
