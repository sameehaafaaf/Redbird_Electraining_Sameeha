VERSION ""

NS_ :

BS_:
BU_:
BO_ 1680 Vector__XXXMsg99: 0 Vector__XXX
   SG_ Vector__XXXMsg99Sig278 : 1|16@1+ (1,0) [0|1] "" Vector__XXX

BA_DEF_ BO_ "GenMsgBackgroundColor" STRING ;
BA_DEF_ BO_ "GenMsgForegroundColor" STRING ;
BA_DEF_ BO_ "filterlabeling" INT 0 0;
BA_ "GenMsgForegroundColor" BO_ 1680 "#aa0000";
BA_ "GenMsgBackgroundColor" BO_ 1680 "#ffaaff";
BA_DEF_DEF_ "GenMsgBackgroundColor" "#ffffff";
BA_DEF_DEF_ "GenMsgForegroundColor" "#000000";
BA_DEF_DEF_ "filterlabeling" 1;
