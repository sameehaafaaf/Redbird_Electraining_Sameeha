VERSION ""

NS_ :

BS_:
BU_:
BO_ 1056 Vector__XXXMsg99: 0 Vector__XXX
   SG_ Vector__XXXMsg99Sig278 : 7|8@1+ (1,0) [0|1] "" Vector__XXX

BA_DEF_ BO_ "GenMsgBackgroundColor" STRING ;
BA_DEF_ BO_ "GenMsgForegroundColor" STRING ;
BA_DEF_ BO_ "filterlabeling" INT 0 0;
BA_ "GenMsgForegroundColor" BO_ 1056 "#5500ff";
BA_ "GenMsgBackgroundColor" BO_ 1056 "#aaffff";
BA_DEF_DEF_ "GenMsgBackgroundColor" "#ffffff";
BA_DEF_DEF_ "GenMsgForegroundColor" "#000000";
BA_DEF_DEF_ "filterlabeling" 1;
VAL_ 1056 Vector__XXXMsg99Sig278 105 "REQUEST";
